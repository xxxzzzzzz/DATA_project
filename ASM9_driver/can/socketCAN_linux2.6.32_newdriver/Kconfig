## ASM9_driver/can/socketCAN_linux2.6.32_newdriver/Kconfig
```kconfig
menuconfig CAN_ASM9260
	tristate "zixin ASM9260 devices"
	depends on CAN_DEV && HAS_IOMEM

if CAN_ASM9260

config CAN_ASM9260_ISA
	tristate "ISA Bus based legacy ASM9260 driver"
	depends on ISA
	---help---
	  This driver adds legacy support for ASM9260 chips connected to
	  the ISA bus using I/O port, memory mapped or indirect access.

config CAN0_ASM9260_PLATFORM
	#tristate "Generic Platform Bus based CAN0 ASM9260 driver"
         tristate "CAN0_ASM9260_PLATFORM"
	---help---
	  This driver adds support for the CAN0 ASM9260 chips connected to
	  the "platform bus" (Linux abstraction for directly to the
	  processor attached devices).  Which can be found on various
	  boards from Phytec (http://www.phytec.de) like the PCM027,
	  PCM038.

config CAN1_ASM9260_PLATFORM
	#tristate "Generic Platform Bus based CAN1 ASM9260  driver"
         tristate "CAN1_ASM9260_PLATFORM"
	---help---
	  This driver adds support for the CAN0 ASM9260 chips connected to
	  the "platform bus" (Linux abstraction for directly to the
	  processor attached devices).  Which can be found on various
	  boards from Phytec (http://www.phytec.de) like the PCM027,
	  PCM038.

config CAN_ASM9260_OF_PLATFORM
	tristate "Generic OF Platform Bus based ASM9260 driver"
	depends on PPC_OF
	---help---
	  This driver adds support for the ASM9260 chips connected to
	  the OpenFirmware "platform bus" found on embedded systems with
	  OpenFirmware bindings, e.g. if you have a PowerPC based system
	  you may want to enable this option.

config CAN_EMS_PCI
	tristate "EMS CPC-PCI, CPC-PCIe and CPC-104P Card"
	depends on PCI
	---help---
	  This driver is for the one, two or four channel CPC-PCI,
	  CPC-PCIe and CPC-104P cards from EMS Dr. Thomas Wuensche
	  (http://www.ems-wuensche.de).

config CAN_KVASER_PCI
	tristate "Kvaser PCIcanx and Kvaser PCIcan PCI Cards"
	depends on PCI
	---help---
	  This driver is for the the PCIcanx and PCIcan cards (1, 2 or
	  4 channel) from Kvaser (http://www.kvaser.com).

endif
```
